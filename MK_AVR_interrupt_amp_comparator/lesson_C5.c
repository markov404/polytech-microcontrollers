/*
 * lesson_C4.c
 *  Использование мультиплексора вместе с компаратором
 *  Контроль превышения напряжений на двух каналах
 *  Светодиод загорится, если напряжение на любом из 
 *  входов превысит 1,23В (напряжение внутреннего ИОН).
 */ 
#include <avr/io.h>
#define F_CPU 1000000
//
int main(void)
{
	//Выводы PB2/AIN0 и PB3/AIN1 на вход без подтягивающего резистора
	DDRB&=~(1<<2);
	DDRB&=~(1<<3);
	//Выводы PD0 и PD1 на выход для подключения светодиодов
	DDRC|=(1<<0)|(1<<1);
	//Компаратор включен по умолчанию
	ACSR&=~(1<<ACD);//(можно не писать)
	//Подключить к неинвертирующему входу компаратора внутренний ИОН (ACBG=1)
	ACSR|=(1<<ACBG);
	
	//Подключаем выход мультиплексора ко входу компаратора
	SFIOR|=(1<<ACME);
	//АЦП выключен по умолчанию
	ADCSRA&=~(1<<ADEN);//(можно не писать)
	
	//
	while (1)
	{	
	//..........Нулевой канал мультиплексора.................
		ADMUX&=~(1<<0);
		ADMUX&=~(1<<1);
		ADMUX&=~(1<<2);
		//Если напряжение на PA0 больше опорного зажечь светодиод
		if(~ACSR&(1<<ACO))PORTC|=(1<<0);
		else PORTC&=~(1<<0);//В противном случае - погасить
	//..........Первый канал мультиплексора...................
		ADMUX|=(1<<0);
		ADMUX&=~(1<<1);
		ADMUX&=~(1<<2);
		//Если напряжение на PA1 больше опорного зажечь светодиод
		if(~ACSR&(1<<ACO))PORTC|=(1<<1);
		else PORTC&=~(1<<1);//В противном случае - погасить
	//..........................................................
	}
}
//ЗАДАЧА: подключить к неинвертирующему входу внешний ИОН на 4,2В.
//Производить контроль уровня напряжения на четырех каналах.
//Смоделировать в Proteus