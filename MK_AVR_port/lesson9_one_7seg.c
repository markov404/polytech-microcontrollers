/*
 * lesson7.c
 * Статическая индикация
 * Подсчет количества нажатий тактовой кнопки на PD6
 * с индикацией на 7-сегментном индикаторе
 * Author: 1
 */ 
#define F_CPU 1000000
#include <util/delay.h>
#include <avr/io.h>
int main(void)
{
	//Массив цифр   0     1     2     3     4     5     6     7     8     9
	char  led[] = {0x3F, 0x06, 0x5B, 0x4F, 0x66, 0x6D, 0x7D, 0x07, 0x7F, 0x6F};
	signed char n=0;//Количество нажатий 
	//Инициализация портов
	DDRC=0b11111111;//Индикатор на порт С
	PORTC=~led[0];//Вывести 0 на идикатор с общим анодом
	DDRD&=~(1<<6);//Вывод для подключения кнопки (на вход)
	PORTD|=(1<<6);//Вывод для подключения кнопки (подключить внутренний подтягивающий резистор)
	//
	while(1)//Бесконечный цикл
	{ 
		if(~PIND&(1<<6))
		{
		_delay_ms(200);//Задержка на дребезг контактов
			if(~PIND&(1<<6))//Если кнопка нажата
			{
			n++;
			if(n>9)n=0;//Сброс подсчитанного количества нажатий
			PORTC=~led[n];//Подать число на индикатор (c общим анодом)
			while(~PIND&(1<<6));//Ждать пока кнопка нажата
			}	
		}		
	}
}
//ЗАДАЧА: По каждому нажатию кнопки PA2 число на индикаторе 
//увеличивается на 1, а по нажатию кнопки PA3 уменьшается на 1
//Индикатор подключить на порт D
//Изменение цифры на индикаторе должно производится по отпусканию кнопки
//Смоделировать в Proteus