/*
 * lesson5.c
 * Динамическая индикация
 * Подсчет количества нажатий тактовой кнопки на PD6 от 0 до 999
 * с индикацией на 7-сегментном индикаторе
 * Author: 1
 */ 
#define F_CPU 1000000
#include <util/delay.h>
#include <avr/io.h>
//Инициализация портов
void Port_ini(void)
{
DDRD=0b11111111;//Катоды индикатора 
DDRC|=(1<<0)|(1<<1)|(1<<6);//Аноды индикатора	
//Кнопка
DDRB&=~(1<<6);
PORTB|=(1<<6);
}
int main(void)
{
	//Массив цифр   0     1     2     3     4     5     6     7     8     9
	char  led[] = {0x3F, 0x06, 0x5B, 0x4F, 0x66, 0x6D, 0x7D, 0x07, 0x7F, 0x6F};
	int n=500;//Количество нажатий 
	char m=0;//Вспомогательная переменная
	char seg1,seg2,seg3;//Переменные для вывода цифр на индикаторы 1, 2 и 3
	Port_ini();//Инициализация портов
	PORTD=~led[0];//Вывести 0 на идикатор с общим анодом
	//
	while(1)//Бесконечный цикл
	{
		//Антидребезг с подсчетом удерживаний
		if(~PINB&(1<<6))//Если кнопка нажата
		{
			m++;//Подсчет "удерживаний" кнопки
			if(m>20)//Если кнопка удерживается более 20*(5+5+5)=300 мс
			{
			n++;
			if(n>999)n=0;//Сброс подсчитанного количества нажатий
			PORTD=~led[n];//Подать число на индикатор (c общим анодом)
			m=0;//Обнулить "удерживания"
			}	
		}
		else m=0;//Если кнопка не нажата, сбросить переменную подсчета удерживаний
		
		 //Разделение числа на цифры
		 seg1=n/100;
		 seg2=n/10%10;
		 seg3=n%10;
		 //..........Вывод цифр............. 
		 PORTD=0xFF;//Очистить индикатор 
		 PORTC&=~(1<<6);
		 PORTC|=(1<<0);
		 PORTD=~led[seg1];
		 _delay_ms(5);
		 //..................................
		 PORTD=0xFF;//Очистить индикатор 
		 PORTC|=(1<<1);
		 PORTC&=~(1<<0);
		 PORTD=~led[seg2];
		 _delay_ms(5);
		 //..................................
		 PORTD=0xFF;//Очистить индикатор 
		 PORTC|=(1<<6);
		 PORTC&=~(1<<1);
		 PORTD=~led[seg3];
		 _delay_ms(5);		
	}
}
//ЗАДАЧА: По каждому нажатию кнопки PB3 число на индикаторе 
//увеличивается на 50, а по нажатию кнопки PB4 уменьшается на 50
//Производить подсчет нажатий от 0 до 9950 с шагом "50"
//Используйте четыре 7-сегментных индикатора
//Смоделировать в Proteus