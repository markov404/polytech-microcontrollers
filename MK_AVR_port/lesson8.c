/*
 * lesson13.c
 *
 * Ввод пароля для сейфа с кейпадом
 *  Author: 1
 */ 
#define F_CPU 1000000
#include <avr/io.h>
#include <util/delay.h>
#include "lcd1602wire4.h"
char n,i,protect;//Вспомогательные переменные
//Инициализация портов
void port_ini(void)
{
//Подключение стоблцов на выход
DDRD|=(1<<0)|(1<<1)|(1<<2);
//Подключение строк на вход с подтяжкой
DDRD&=~(1<<3)&~(1<<4)&~(1<<5)&~(1<<6);
PORTD|=(1<<3)|(1<<4)|(1<<5)|(1<<6);	
}
//Опрос кейпада
int Keypad_scan()
{
n=10;//Ни одна кнопка не нажата
//...............Опрос первого столбца............................
PORTD&=~(1<<0);
PORTD|=(1<<1)|(1<<2);
if(~PIND&(1<<3))n=1;
if(~PIND&(1<<4))n=4;
if(~PIND&(1<<5))n=7;
if(~PIND&(1<<6))n=0x2A-0x30;//Звездочка "*" 0x2A
//...............Опрос второго столбца............................
PORTD&=~(1<<1);
PORTD|=(1<<0)|(1<<2);	
if(~PIND&(1<<3))n=2;
if(~PIND&(1<<4))n=5;
if(~PIND&(1<<5))n=8;
if(~PIND&(1<<6))n=0;
//...............Опрос третьего столбца............................
PORTD&=~(1<<2);
PORTD|=(1<<0)|(1<<1);
if(~PIND&(1<<3))n=3;
if(~PIND&(1<<4))n=6;
if(~PIND&(1<<5))n=9;
if(~PIND&(1<<6))n=0x23-0x30;//Решётка "#" 0x23
return n;
}
//Основная программа
int main(void)
{
	//Инициализация портов
	port_ini();
	//Инициализация дисплея
	LCD_ini();
	//Показать курсор
	visible_cursor();
	//Очистка дисплея
	clear_LCD();
	setpos_to_LCD(0,0);
	string_to_LCD("Enter password:");
	setpos_to_LCD(5,1);
	//
	while (1)
	{
	//Опрос кейпада
	n=Keypad_scan();
//...................................................................
//........Выполнять условие только если были нажатия кнопок..........
	if(n != 10)
	{
	i++;//подсчет числа введенных символов
	//Отправить символ с кейпада на дисплей
	sendbyte_to_LCD(n+0x30,1);
	_delay_ms(300);	
	//.......Определение корректности вводимого пароля................
	//Верный пароль: 564
		if(n==5 && i==1)protect=1;
		if(n==5 && protect==1)protect=2;
		if(n==4 && protect==2)protect=3;
	//...............Действия после ввода пароля.......................
		if(i==3)//Когда чисто нажатий кнопок достигло трех
		{
		i=0;//Обнулить число нажатий кнопок
		//Вывести с 5-го столбца 2-й строки 
		setpos_to_LCD(5,1); //(0 - первая строка, 1 - вторая)
		//Вывести сообщение о верности пароля в зависимости от того, смогла
		//ли переменная защиты protect достигнуть "3"
		if(protect==3)string_to_LCD("TRUE!   ");
		else string_to_LCD("FALSE!   ");
		protect=0;//Обнуление переменной защиты
		_delay_ms(1000);//Удерживать сообщение о 
		//верности/неверности пароля в течении 1 секунды
		//Очистить дисплей и ввести запрос пароля:
		clear_LCD();
		setpos_to_LCD(0,0);
		string_to_LCD("Enter password:");
		setpos_to_LCD(5,1);
		
		}
//.....................................................................
//.....................................................................
	}	
	}
}
//ЗАДАЧА: Сделать пароль на 6 символов
//Поставить 1 светодиод (зажигается когда пароль верный)
//Гасить этот светодиод после нажатия любой кнопки кейпада
//Отображение цифр пароля на дисплее заменить звездочками
//Смоделировать в Proteus