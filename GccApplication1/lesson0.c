/*
 * lesson0.c
 * По нажатию кнопки зажигается синий светодиод, а зеленый гаснет
 *  Author: 1
 */  
#include <avr/io.h>
//Основная программа
int main(void)
{
	//int count = 0;
	DDRC|=(1<<2);//Вывод PC2 на выход (зеленый светодиод)
	DDRD|=(1<<4);//Вывод PD4 на выход (синий светодиод)
	DDRB|=(1<<6);//Вывод PB6 на выход (синий светодиод)
	DDRB&=~(1<<2);//Вывод PB2 на вход (кнопка K1)
	PORTB|=(1<<2);//Подтягивающий резистор на PB2
	DDRA&=~(1<<4);//Вывод PA4 на вход (кнопка K2)
	PORTA|=(1<<4);//Подтягивающий резистор на PA4
	//

	while (1)
	{
		if(~PINB&(1<<2))//Если кнопка K1 нажата
		{
		PORTD|=(1<<4);//Зажечь синий светодиод
		PORTC&=~(1<<2);//Погасить зелёный светодиод
		}
		else//Если кнопка K1 отжата
		{
		PORTD&=~(1<<4);//Погасить синий светодиод
		PORTC|=(1<<2);//Зажечь зелёный светодиод
		}
		if(~PINA&(1<<4))
		{
			PORTB&=~(1<<6);
		}
		else
		{
			PORTB|=(1<<6);
		}
	}
	

/*
while (1)
{
	if (~PINB&(1<<2))
	{
		PORTB|=(1<<6);
		PORTD|=(1<<4);
		PORTC|=(1<<2);
	}
	if (~PINA&(1<<4))
	{
		PORTB&=~(1<<6);
		PORTD&=~(1<<4);
		PORTC&=~(1<<2);
	}
}
*/
/*
while (1)
{
	if (~PINB&(1<<2))
	{
		count += 1;
	}
	if (~PINA&(1<<4) && (count % 2 == 1))
	{
		PORTB|=(1<<6);
		PORTD|=(1<<4);
		PORTC|=(1<<2);
	}
	else
	{
		PORTB&=~(1<<6);
		PORTD&=~(1<<4);
		PORTC&=~(1<<2);	
	}
}
*/
}

//ЗАДАЧА 1: Добавить кнопку на PA4 и светодиод на PB6. 
//          По нажатию кнопки K2 светодиод на PB6 должен гаснуть
//ЗАДАЧА 2: По нажатию кнопки K1 все светодиоды должны зажигаться,
//          по нажатию кнопки K2 - тухнуть.
//ЗАДАЧА 3: По нажатию кнопки K2 все светодиоды должны зажигаться,
//          по её отжатию - тухнуть. Такой алгоритм должен работать,
//          если K1 нажата
//Смоделировать в Proteus