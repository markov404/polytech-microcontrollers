/*
 * lesson_C2.c
 * Компаратор для управления электродвигателем вентилятора
 */ 
#include <avr/io.h>
#define F_CPU 1000000
//
int main(void)
{
	//Выводы PB2/AIN0 и PB3/AIN1 на выход без подтягивающего резистора
	DDRB&=~(1<<2);
	DDRB&=~(1<<3);
	DDRD|=(1<<2);
	DDRD|=(1<<3);	
	
	//Вывод PB6 на выход для управления вентилятором
	DDRB|=(1<<6);
	//Компаратор включен по умолчанию 
	ACSR&=~(1<<ACD);//можно не писать
	ACSR|=(1<<ACBG);
	//
	while (1)
	{
	//Если напряжение на инверсном входе AIN1 больше опорного включить вентилятор
	if(~ACSR&(1<<ACO))PORTB|=(1<<6);
	else PORTB&=~(1<<6);//В противном случае - выключить
	
	if (~ACSR&(1<<ACO))
	{
		PORTD|=(1<<2);
		PORTD&=~(1<<3);
	}
	else
	{
		PORTD|=(1<<3);
		PORTD&=~(1<<2);
	}
	}
}
//ЗАДАЧА: подключить к неинвертирующему входу внутренний ИОН 1,23В вместо внешнего на PB2.
// (срабатывание вентилятора должно быть при превышении 123 град.С без регулировки)
//Поставить 2 светодиода: красный горит когда температура превышена и работает
//вентилятор, зеленый - когда температура в норме.
//Смоделировать в Proteus