/*
 * lesson2.c
 * Смена режима свечения индикатора 
 * по нажатию кнопки на выводе PB0
 *  Author: 1
 */ 

// Дерективы
#include <avr/io.h>
#define F_CPU 1000000
#include <util/delay.h>
//Инициализация портов
void Port_ini(void)
{
	//Подключения индикатора
	DDRD=0xFF;
	//Подключение кнопки 
	DDRB&=~(1<<0);
	PORTB|=(1<<0);	
}
//Основная программа
int main(void)
{
	Port_ini();//Инициализация портов
	signed char i,n=0;//Вспомогательные переменные
	//
	while (1)
	{
//........................................................................................
	//Действия по нажатию кнопки
	if(~PINB&(1<<0))//Если кнопка нажата
	{
	_delay_ms(200);//Задержка на дребезг контактов
		if(~PINB&(1<<0))//Если кнопка нажата
		{
		n++;//Установить следующий по счету режим
		if(n>5)n=0;//Ограничение n до 2(количества возможных режимов 3: 0,1,2) 
		PORTD=0x00;//Погасить индикатор
		while(~PINB&(1<<0));//Ждать пока кнопка нажата
		}		
	}
//........................................................................................
	//Реализация режима свечения в зависимости от значения n
		switch (n)
		{
		//................................
		case 4:
                //Сдвиг огонька сверху вниз
			for(i=0;i<=7;i++)
			{
			PORTD=(1<<i);
			_delay_ms(250); 
			}
		break;
		//.................................
		case 1:
		//Сдвиг двух огоньков сверху вниз
			for(i=0;i<=6;i++)
			{
			PORTD=(1<<i)|(1<<(7-i));
			_delay_ms(250);
			}			
		break;
		//.................................
		case 2:
			for(i=0;i<=7;i++)
			{
			PORTD|=(1<<i);
			_delay_ms(250);
			}
			//
			for(i=7;i>=0;i--)
			{
			PORTD&=~(1<<i);
			_delay_ms(250);
			}	
		break;
		case 3:
			for(i = 3; i >= 0; i--)
			{
				PORTD|=(1<<i);
				PORTD|=(1<<(7 - i));
				_delay_ms(250);
			}
			for(i = 0; i <= 3; i++)
			{
				PORTD&=~(1<<i);
				PORTD&=~(1<<(7-i));
				_delay_ms(250);
			}
		break;
		case 0:
			while(1)
			{
				PORTD=0xFF;
				_delay_ms(10);
				PORTD=0x00;
				_delay_ms(10);
			}
			break;
		//..................................
		
	}
}
}

//ЗАДАЧА: Добавить еще 2 режима работы индикатора:
// 1 - сдвиг огоньков от центра индикатора к его краям и гашение от краев к центру
// 2 - одновременное мигание всеми светодиодами
//Смоделировать в Proteus