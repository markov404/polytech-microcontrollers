/*
 * lesson_C1.c
 * Поочередное зажигание светодиодов по кнопке
 * сверху вниз с использованием внешних прерываний
 */ 
#define F_CPU 1000000
#include <util/delay.h>
#include <avr/io.h>
//
#include <avr/interrupt.h> //Подключить библиотеку прерываний
//
//вспомогательная переменная
char i=8;
int j = 8;
//Инициализация внешнего прерывания
void Interrupt_ini(void)
{
	sei();//Глобальное разрешение прерываний
	GICR|=(1<<INT0);//разрешить прерывания для входа INT0
	MCUCR|=(1<<ISC01);//Прерывание на INT0 по спадающему фронту
	
	GICR|=(1<<INT1);
	MCUCR|=(1<<ISC11);
	
	GICR|=(1<<INT2);
	MCUCR|=(1<<ISC2);
}
//Настройка портов
void Port_ini(void)
{
	//Порт С на выход
	DDRC=0xFF;
	//Вывод PD2 на вход с подтяжкой
	DDRD&=~(1<<2);
	PORTD|=(1<<2);
	
	DDRB&=~(1<<2);
	PORTB|=(1<<2);
	
	DDRD&=~(1<<3);
	PORTD|=(1<<3);
}
//Функция обработки прерывания по выводу INT0 (PD2)
ISR(INT0_vect)
{
	_delay_ms(200);
	if(~PIND&(1<<2))//Если кнопка на PD2 была нажата
	{
		PORTC|=(1<<i);
		i++;
		if (i>8)
		{
		i=0;
		PORTC=0x00;	
		}
	}
}
ISR(INT1_vect)
{
	_delay_ms(200);
	if(~PIND&(1<<3))//Если кнопка на PD2 была нажата
	{
		PORTC|=(1<<j);
		j--;
		if (j<-1)
		{
			j=8;
			PORTC=0x00;
		}
	}
}
ISR(INT2_vect)
{
	_delay_ms(200);
	if(~PINB&(1<<2))//Если кнопка на PD2 была нажата
	{
		PORTC=0x00;
		j = 7;
		i = 0;
	}
	
}

//
int main(void)
{
	//Настройка прерываний
	Interrupt_ini();
	//Настройка портов
	Port_ini();
	//
	while(1)//Пустой бесконечный цикл
	{
	}
}
//ЗАДАЧА: Добавить в схему две кнопки: по нажатии первой
//будет происходить поочередное зажигание светодиодов снизу-вверх
//По нажатии второй кнопки все светодиоды гаснут
//Использовать ТОЛЬКО прерывания. Основной цикл while(1) оставить пустым.
//Смоделировать в Proteus